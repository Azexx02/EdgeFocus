#include "ssd1306.h"
#include <string.h>

static uint8_t _buffer[SSD1306_WIDTH * SSD1306_HEIGHT / 8];
static I2C_HandleTypeDef *_hi2c;
static uint8_t _addr;  // 8-bit address (left-shifted)

// 6x8 ASCII font (space ~ tilde) - same as ESP32 version
static const uint8_t font6x8[][6] = {
    {0x00,0x00,0x00,0x00,0x00,0x00}, // space
    {0x00,0x00,0x5F,0x00,0x00,0x00}, // !
    {0x00,0x07,0x00,0x07,0x00,0x00}, // "
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    {0x10,0x08,0x08,0x10,0x08,0x00}, // ~
};

static HAL_StatusTypeDef _write_cmd(uint8_t cmd)
{
    uint8_t buf[2] = {0x00, cmd};
    return HAL_I2C_Master_Transmit(_hi2c, _addr, buf, 2, 100);
}

static HAL_StatusTypeDef _write_cmds(const uint8_t *cmds, uint16_t len)
{
    uint8_t buf[32];
    buf[0] = 0x00; // control byte: command
    for (uint16_t i = 0; i < len && i < 31; i++) {
        buf[i + 1] = cmds[i];
    }
    return HAL_I2C_Master_Transmit(_hi2c, _addr, buf, len + 1, 100);
}

static HAL_StatusTypeDef _write_data(const uint8_t *data, uint16_t len)
{
    // SSD1306 I2C: control byte 0x40 before data
    // HAL_I2C_Mem_Write handles this well for bulk transfers
    return HAL_I2C_Mem_Write(_hi2c, _addr, 0x40, I2C_MEMADD_SIZE_8BIT,
                             (uint8_t *)data, len, 100);
}

HAL_StatusTypeDef ssd1306_init(const ssd1306_config_t *config)
{
    _hi2c = config->hi2c;
    _addr = config->i2c_addr << 1;  // HAL expects left-shifted address

    // SSD1306 initialization sequence (same as ESP32 version)
    uint8_t init_cmds[] = {
        0xAE,       // Display OFF
        0xD5, 0x80, // Set display clock
        0xA8, 0x1F, // Set multiplex ratio 1/32
        0xD3, 0x00, // Set display offset
        0x40,       // Set start line = 0
        0x8D, 0x14, // Charge pump enable
        0x20, 0x00, // Horizontal addressing mode
        0xA1,       // Segment re-map
        0xC8,       // COM scan direction
        0xDA, 0x02, // COM pins config (for 32-row)
        0x81, 0xCF, // Set contrast
        0xD9, 0xF1, // Pre-charge period
        0xDB, 0x40, // VCOMH deselect level
        0xA4,       // Display from RAM
        0xA6,       // Normal display
        0xAF,       // Display ON
    };

    HAL_StatusTypeDef ret = _write_cmds(init_cmds, sizeof(init_cmds));
    if (ret != HAL_OK) return ret;

    ssd1306_clear();
    ssd1306_update();

    return HAL_OK;
}

HAL_StatusTypeDef ssd1306_clear(void)
{
    memset(_buffer, 0, sizeof(_buffer));
    return HAL_OK;
}

HAL_StatusTypeDef ssd1306_display_on(void)
{
    return _write_cmd(0xAF);
}

HAL_StatusTypeDef ssd1306_display_off(void)
{
    return _write_cmd(0xAE);
}

HAL_StatusTypeDef ssd1306_draw_pixel(uint8_t x, uint8_t y, bool on)
{
    if (x >= SSD1306_WIDTH || y >= SSD1306_HEIGHT) return HAL_ERROR;

    uint16_t idx = x + (y / 8) * SSD1306_WIDTH;
    if (on)
        _buffer[idx] |= (1 << (y & 7));
    else
        _buffer[idx] &= ~(1 << (y & 7));

    return HAL_OK;
}

HAL_StatusTypeDef ssd1306_draw_string(uint8_t page, uint8_t col, const char *str)
{
    while (*str) {
        char c = *str;
        if (c < 0x20 || c > 0x7E) c = '?';
        uint8_t idx = c - 0x20;

        for (int i = 0; i < 6; i++) {
            _buffer[page * SSD1306_WIDTH + col + i] = font6x8[idx][i];
        }
        col += 6;
        str++;
    }
    return HAL_OK;
}

HAL_StatusTypeDef ssd1306_update(void)
{
    // Set column address range and page address range
    uint8_t addr_cmds[] = {
        0x21, 0x00, 0x7F, // Column address 0-127
        0x22, 0x00, 0x03, // Page address 0-3 (32-row display)
    };
    HAL_StatusTypeDef ret = _write_cmds(addr_cmds, sizeof(addr_cmds));
    if (ret != HAL_OK) return ret;

    // Send entire buffer (512 bytes for 128x32)
    return _write_data(_buffer, sizeof(_buffer));
}

// ─── 16x16 大数字字模（用于倒计时，每个数字占 16 列 x 2 页） ───
// 数字 0-9 和冒号 ':'，每字符 16 列，分上下两页各 8 行
static const uint8_t font16x16[][32] = {
    // 0
    {0xF0,0xFE,0xFF,0x0F,0x03,0x03,0x03,0x0F,0xFF,0xFE,0xF0,0x00,0x00,0x00,
     0x0F,0x3F,0xFF,0xFC,0xC0,0xC0,0xC0,0xFC,0xFF,0x3F,0x0F,0x00,0x00,0x00,
     0x00,0x00,0x00,0x00},
    // 1
    {0x00,0x00,0x0C,0x0E,0xFF,0xFF,0xFF,0x00,0x00,0x00,0x00,0x00,0x00,0x00,
     0x00,0x00,0xC0,0xC0,0xFF,0xFF,0xFF,0xC0,0xC0,0x00,0x00,0x00,0x00,0x00,
     0x00,0x00,0x00,0x00},
    // 2
    {0x00,0x07,0x07,0x03,0x83,0xC3,0xE3,0x7F,0x3F,0x1F,0x00,0x00,0x00,0x00,
     0xE0,0xF0,0xFC,0xFE,0xDF,0xC7,0xC1,0xC0,0xC0,0xC0,0xC0,0x00,0x00,0x00,
     0x00,0x00,0x00,0x00},
    // 3
    {0x00,0x03,0x03,0x03,0x83,0x83,0x83,0xFF,0xFF,0x7E,0x00,0x00,0x00,0x00,
     0x7C,0xFE,0xFF,0xC7,0xC3,0xC3,0xC3,0xFF,0xFE,0x7C,0x00,0x00,0x00,0x00,
     0x00,0x00,0x00,0x00},
    // 4
    {0x00,0x00,0x80,0xE0,0xF8,0x7E,0x1F,0xFF,0xFF,0xFF,0x00,0x00,0x00,0x00,
     0x0F,0x0F,0x0D,0x0C,0x0C,0x0C,0x0C,0xFF,0xFF,0xFF,0x0C,0x00,0x00,0x00,
     0x00,0x00,0x00,0x00},
    // 5
    {0x00,0x00,0x7F,0x7F,0x63,0x63,0x63,0xE3,0xE3,0xC3,0x00,0x00,0x00,0x00,
     0x7C,0xFE,0xFF,0xC3,0xC0,0xC0,0xC0,0xFF,0xFF,0x7F,0x00,0x00,0x00,0x00,
     0x00,0x00,0x00,0x00},
    // 6
    {0xE0,0xFC,0xFF,0x3F,0x07,0x03,0x03,0x07,0x0F,0x0E,0x00,0x00,0x00,0x00,
     0x7F,0xFF,0xFF,0xE3,0xC0,0xC0,0xC0,0xFF,0xFF,0x7F,0x00,0x00,0x00,0x00,
     0x00,0x00,0x00,0x00},
    // 7
    {0x00,0x03,0x03,0x03,0x83,0xE3,0xF3,0x7F,0x3F,0x0F,0x00,0x00,0x00,0x00,
     0x00,0x00,0xE0,0xFC,0xFF,0x1F,0x03,0x00,0x00,0x00,0x00,0x00,0x00,0x00,
     0x00,0x00,0x00,0x00},
    // 8
    {0x00,0x3E,0x7F,0xFF,0xC3,0xC3,0xC3,0xFF,0x7F,0x3E,0x00,0x00,0x00,0x00,
     0x7C,0xFE,0xFF,0xC3,0xC3,0xC3,0xFF,0xFF,0xFE,0x7C,0x00,0x00,0x00,0x00,
     0x00,0x00,0x00,0x00},
    // 9
    {0x00,0x1E,0x3F,0xFF,0xC3,0xC3,0xC3,0xFF,0xFE,0xF0,0x00,0x00,0x00,0x00,
     0x00,0xFE,0xFF,0xFF,0xC1,0xC0,0xC0,0xF0,0x7F,0x3F,0x00,0x00,0x00,0x00,
     0x00,0x00,0x00,0x00},
    // : (冒号)
    {0x00,0x00,0x00,0x00,0x00,0x70,0x70,0x70,0x00,0x00,0x00,0x00,0x00,0x00,
     0x00,0x00,0x00,0x00,0x00,0x1C,0x1C,0x1C,0x00,0x00,0x00,0x00,0x00,0x00,
     0x00,0x00,0x00,0x00},
};

// 在指定位置绘制 16x16 大字符（col 为列起始，page 为页起始 0 或 2）
static void _draw_big_char(uint8_t page, uint8_t col, char c)
{
    int idx;
    if (c >= '0' && c <= '9') idx = c - '0';
    else if (c == ':') idx = 10;
    else return;

    for (int i = 0; i < 16; i++) {
        if (col + i < SSD1306_WIDTH)
            _buffer[page * SSD1306_WIDTH + col + i] = font16x16[idx][i];
    }
    for (int i = 0; i < 16; i++) {
        if (col + i < SSD1306_WIDTH)
            _buffer[(page + 1) * SSD1306_WIDTH + col + i] = font16x16[idx][16 + i];
    }
}

void ssd1306_show_countdown_status(uint32_t seconds, const char *status, const char *battery)
{
    char buf[6];
    uint32_t mm = seconds / 60U;
    uint32_t ss = seconds % 60U;

    if (mm > 99U) {
        mm = 99U;
        ss = 59U;
    }

    buf[0] = (char)('0' + (mm / 10U) % 10U);
    buf[1] = (char)('0' + mm % 10U);
    buf[2] = ':';
    buf[3] = (char)('0' + (ss / 10U) % 10U);
    buf[4] = (char)('0' + ss % 10U);
    buf[5] = '\0';

    ssd1306_clear();

    // 5 chars x 16 columns = 80 columns, centered on 128 columns.
    uint8_t col = 24;
    for (int i = 0; i < 5; i++) {
        _draw_big_char(0, col, buf[i]);
        col += 16;
    }

    if (status != NULL) {
        ssd1306_draw_string(2, 0, status);
    }
    if (battery != NULL) {
        ssd1306_draw_string(3, 0, battery);
    }
    ssd1306_update();
}

void ssd1306_show_countdown_seconds(uint32_t seconds)
{
    ssd1306_show_countdown_status(seconds, "Counting", "");
}

void ssd1306_show_countdown(uint16_t minutes)
{
    ssd1306_show_countdown_seconds((uint32_t)minutes * 60U);
}

void ssd1306_show_alert(uint8_t level)
{
    ssd1306_clear();
    ssd1306_draw_string(0, 0, "*** ALERT! ***");

    switch (level) {
        case 1: ssd1306_draw_string(1, 0, "Level 1: Mild");   break;
        case 2: ssd1306_draw_string(1, 0, "Level 2: Phone");  break;
        case 3: ssd1306_draw_string(1, 0, "Level 3: Severe"); break;
        case 4: ssd1306_draw_string(1, 0, "Rest Suggested");  break;
        default: ssd1306_draw_string(1, 0, "Unknown level");   break;
    }

    // 画边框表示警告
    for (int x = 0; x < SSD1306_WIDTH; x++) {
        ssd1306_draw_pixel(x, 0, true);
        ssd1306_draw_pixel(x, SSD1306_HEIGHT - 1, true);
    }
    for (int y = 0; y < SSD1306_HEIGHT; y++) {
        ssd1306_draw_pixel(0, y, true);
        ssd1306_draw_pixel(SSD1306_WIDTH - 1, y, true);
    }

    ssd1306_update();
}
