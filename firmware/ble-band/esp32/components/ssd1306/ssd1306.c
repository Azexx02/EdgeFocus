#include "ssd1306.h"
#include "driver/i2c_master.h"
#include "esp_log.h"
#include <string.h>

static const char *TAG = "ssd1306";

static uint8_t _buffer[SSD1306_WIDTH * SSD1306_HEIGHT / 8];
static i2c_master_dev_handle_t _dev_handle;

// 6x8 ASCII font (space ~ tilde)
static const uint8_t font6x8[][6] = {
    {0x00,0x00,0x00,0x00,0x00,0x00}, // space
    {0x00,0x00,0x5F,0x00,0x00,0x00}, // !
    {0x00,0x07,0x00,0x07,0x00,0x00}, // "
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    {0x10,0x08,0x08,0x10,0x08,0x00}, // ~
};

static esp_err_t _write_cmd(uint8_t cmd)
{
    uint8_t buf[2] = {0x00, cmd};
    return i2c_master_transmit(_dev_handle, buf, 2, 100);
}

static esp_err_t _write_cmds(const uint8_t *cmds, size_t len)
{
    uint8_t buf[32];
    buf[0] = 0x00; // control byte: command
    for (size_t i = 0; i < len; i++) {
        buf[i + 1] = cmds[i];
    }
    return i2c_master_transmit(_dev_handle, buf, len + 1, 100);
}

static esp_err_t _write_data(const uint8_t *data, size_t len)
{
    // Need control byte 0x40 before data
    uint8_t *buf = malloc(len + 1);
    if (!buf) return ESP_ERR_NO_MEM;
    buf[0] = 0x40;
    memcpy(&buf[1], data, len);
    esp_err_t ret = i2c_master_transmit(_dev_handle, buf, len + 1, 100);
    free(buf);
    return ret;
}

esp_err_t ssd1306_init(const ssd1306_config_t *config)
{
    // Create I2C master bus
    i2c_master_bus_config_t bus_config = {
        .i2c_port = I2C_NUM_0,
        .sda_io_num = config->sda_pin,
        .scl_io_num = config->scl_pin,
        .clk_source = I2C_CLK_SRC_DEFAULT,
        .glitch_ignore_cnt = 7,
        .flags.enable_internal_pullup = true,
    };

    i2c_master_bus_handle_t bus_handle;
    esp_err_t ret = i2c_new_master_bus(&bus_config, &bus_handle);
    if (ret != ESP_OK) {
        ESP_LOGE(TAG, "Failed to create I2C bus: %s", esp_err_to_name(ret));
        return ret;
    }

    // Add SSD1306 device
    i2c_device_config_t dev_config = {
        .dev_addr_length = I2C_ADDR_BIT_LEN_7,
        .device_address = config->i2c_addr,
        .scl_speed_hz = 400000,
    };

    ret = i2c_master_bus_add_device(bus_handle, &dev_config, &_dev_handle);
    if (ret != ESP_OK) {
        ESP_LOGE(TAG, "Failed to add I2C device at 0x%02X: %s", config->i2c_addr, esp_err_to_name(ret));
        return ret;
    }

    ESP_LOGI(TAG, "I2C device added at address 0x%02X", config->i2c_addr);

    // SSD1306 initialization sequence
    uint8_t init_cmds[] = {
        0xAE,       // Display OFF
        0xD5, 0x80, // Set display clock
        0xA8, 0x1F, // Set multiplex ratio 1/32
        0xD3, 0x00, // Set display offset
        0x40,       // Set start line = 0
        0x8D, 0x14, // Charge pump enable
        0x20, 0x00, // Horizontal addressing mode
        0xA1,       // Segment re-map
        0xC8,       // COM scan direction
        0xDA, 0x02, // COM pins config (for 32-row)
        0x81, 0xCF, // Set contrast
        0xD9, 0xF1, // Pre-charge period
        0xDB, 0x40, // VCOMH deselect level
        0xA4,       // Display from RAM
        0xA6,       // Normal display
        0xAF,       // Display ON
    };

    ret = _write_cmds(init_cmds, sizeof(init_cmds));
    if (ret != ESP_OK) {
        ESP_LOGE(TAG, "Failed to send init commands: %s", esp_err_to_name(ret));
        return ret;
    }

    ssd1306_clear();
    ssd1306_update();

    ESP_LOGI(TAG, "SSD1306 initialized successfully");
    return ESP_OK;
}

esp_err_t ssd1306_clear(void)
{
    memset(_buffer, 0, sizeof(_buffer));
    return ESP_OK;
}

esp_err_t ssd1306_display_on(void)
{
    return _write_cmd(0xAF);
}

esp_err_t ssd1306_display_off(void)
{
    return _write_cmd(0xAE);
}

esp_err_t ssd1306_draw_pixel(uint8_t x, uint8_t y, bool on)
{
    if (x >= SSD1306_WIDTH || y >= SSD1306_HEIGHT) return ESP_ERR_INVALID_ARG;

    uint16_t idx = x + (y / 8) * SSD1306_WIDTH;
    if (on)
        _buffer[idx] |= (1 << (y & 7));
    else
        _buffer[idx] &= ~(1 << (y & 7));

    return ESP_OK;
}

esp_err_t ssd1306_draw_string(uint8_t page, uint8_t col, const char *str)
{
    while (*str) {
        char c = *str;
        if (c < 0x20 || c > 0x7E) c = '?';
        uint8_t idx = c - 0x20;

        for (int i = 0; i < 6; i++) {
            _buffer[page * SSD1306_WIDTH + col + i] = font6x8[idx][i];
        }
        col += 6;
        str++;
    }
    return ESP_OK;
}

esp_err_t ssd1306_update(void)
{
    // Set column address range and page address range
    uint8_t addr_cmds[] = {
        0x21, 0x00, 0x7F, // Column address 0-127
        0x22, 0x00, 0x03, // Page address 0-3 (32-row display)
    };
    esp_err_t ret = _write_cmds(addr_cmds, sizeof(addr_cmds));
    if (ret != ESP_OK) return ret;

    // Send entire buffer
    return _write_data(_buffer, sizeof(_buffer));
}
